/* Scanout path benchmark: convert a linear XRGB8888 desktop buffer into the tiled
 * scanout format, once on the CPU (what the xenos DRM driver does today) and once
 * on the GPU (textured quad + EDRAM resolve). Compares speed and output. */
#include <stdio.h>
#include <stdlib.h>
#include <stdint.h>
#include <string.h>
#include <time.h>
#include <unistd.h>
#include "../libxe/xe.h"
#include "../libxe/xe_linux.h"
#include "../libxe/edram.h"
#include "../libxe/xe_dump.h"

static double now(void){struct timespec t;clock_gettime(CLOCK_MONOTONIC,&t);return t.tv_sec+t.tv_nsec*1e-9;}

static unsigned char shader_3d_ps[] = {
	0x10, 0x2a, 0x11, 0x00, 0x00, 0x00, 0x00, 0xdc, 0x00, 0x00, 0x00, 0x48,
	0x00, 0x00, 0x00, 0x00, 0x00, 0x00, 0x00, 0x24, 0x00, 0x00, 0x00, 0x00,
	0x00, 0x00, 0x00, 0xb4, 0x00, 0x00, 0x00, 0x00, 0x00, 0x00, 0x00, 0x00,
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	0x00, 0x00, 0x00, 0x00
};

static unsigned char shader_3d_vs[] = {
	0x10, 0x2a, 0x11, 0x01, 0x00, 0x00, 0x01, 0x04, 0x00, 0x00, 0x00, 0xb4,
	0x00, 0x00, 0x00, 0x00, 0x00, 0x00, 0x00, 0x24, 0x00, 0x00, 0x00, 0x00,
	0x00, 0x00, 0x00, 0xb8, 0x00, 0x00, 0x00, 0x00, 0x00, 0x00, 0x00, 0x00,
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	0x00, 0x00, 0x00, 0x00, 0x00, 0x00, 0x00, 0x00
};


/* exactly the xenos DRM driver's xenos_blit() inner loop */
static void cpu_blit(uint32_t *dst, const uint32_t *src, int w, int h, int pitch_px)
{
	for (int y = 0; y < h; y++)
		for (int x = 0; x < w; x += 4) {
			int ndx = ((((y & ~31) * w) + (x & ~31) * 32) +
				   (((x & 3) + ((y & 1) << 2) + ((x & 28) << 1) + ((y & 30) << 5)) ^ ((y & 8) << 2)));
			uint32_t *d = dst + ndx;
			const uint32_t *s = src + x + y * pitch_px;
			d[0] = __builtin_bswap32(s[0]); d[1] = __builtin_bswap32(s[1]);
			d[2] = __builtin_bswap32(s[2]); d[3] = __builtin_bswap32(s[3]);
		}
}

int main(int argc, char **argv)
{
	int iters = argc > 1 ? atoi(argv[1]) : 60;
	int texfmt = getenv("XE_TEXFMT") ? (int)strtol(getenv("XE_TEXFMT"), 0, 0) : (XE_FMT_8888 | XE_FMT_ARGB); /* 0x86 */
	float uoff = getenv("XE_UOFF") ? atof(getenv("XE_UOFF")) : 0.5f; /* half-texel: D3D9-style pixel centres */
	setvbuf(stdout, NULL, _IONBF, 0);
	static struct XenosDevice xe_s; struct XenosDevice *xe = &xe_s;
	if (xe_linux_open()) return 1;
	Xe_Init(xe);
	if (getenv("XE_EDRAM_INIT")) edram_init(xe);  /* normally done once at boot by xeinit */
	int W = Xe_GetFramebufferSurface(xe)->width, H = Xe_GetFramebufferSurface(xe)->height;

	/* desktop-like test image in X's XRGB8888 (native big-endian words 0x00RRGGBB) */
	struct XenosSurface *src = Xe_CreateTexture(xe, W, H, 1, texfmt, 0);
	src->use_filtering = 0;
	src->u_addressing = src->v_addressing = XE_TEXADDR_CLAMP;
	int spitch = src->wpitch / 4;
	uint32_t *img = malloc(W * H * 4);
	for (int y = 0; y < H; y++)
		for (int x = 0; x < W; x++) {
			uint32_t r = x * 255 / W, g = y * 255 / H, b = ((x / 16) ^ (y / 16)) & 1 ? 0xff : 0x30;
			if ((x % 97) == 0 || (y % 61) == 0) r = g = b = 0xff;     /* thin lines catch off-by-one */
			img[y * W + x] = (r << 16) | (g << 8) | b;
		}
	uint32_t *sv = xe_linux_phys_to_virt(src->ptr);
	for (int y = 0; y < H; y++) memcpy(sv + y * spitch, img + y * W, W * 4);

	struct XenosSurface *cpu_dst = Xe_CreateTexture(xe, W, H, 1, XE_FMT_8888 | XE_FMT_BGRA | XE_FMT_NOSWAP, 1);
	/* the R/B swap in the resolve undoes the texture fetch order: X XRGB words -> scanout BGRX bytes */
	struct XenosSurface *gpu_dst = Xe_CreateTexture(xe, W, H, 1, XE_FMT_8888 | XE_FMT_BGRA, 1);
	uint32_t *cd = xe_linux_phys_to_virt(cpu_dst->ptr), *gd = xe_linux_phys_to_virt(gpu_dst->ptr);

	/* CPU path: cached source (like the DRM shadow buffer), uncached destination */
	double t = now();
	for (int i = 0; i < iters; i++) cpu_blit(cd, img, W, H, W);
	double cpu_ms = (now() - t) * 1000 / iters;

	/* GPU path */
	static const struct XenosVBFFormat vbf = { 5, {
		{XE_USAGE_POSITION, 0, XE_TYPE_FLOAT3}, {XE_USAGE_NORMAL, 0, XE_TYPE_FLOAT3},
		{XE_USAGE_TANGENT, 0, XE_TYPE_FLOAT3}, {XE_USAGE_COLOR, 0, XE_TYPE_UBYTE4},
		{XE_USAGE_TEXCOORD, 0, XE_TYPE_FLOAT2} } };
	struct XenosShader *sps = Xe_LoadShaderFromMemory(xe, shader_3d_ps); Xe_InstantiateShader(xe, sps, 0);
	struct XenosShader *svs = Xe_LoadShaderFromMemory(xe, shader_3d_vs); Xe_InstantiateShader(xe, svs, 0);
	Xe_ShaderApplyVFetchPatches(xe, svs, 0, &vbf);
	float u0 = uoff / W, v0 = uoff / H, u1 = 1 + uoff / W, v1 = 1 + uoff / H;
	float quad[] = {
		/* pos            normal      tangent   col  uv */
		-1, -1, 0,   0, 0, -1,   1, 0, 0,   0,   u0, v1,
		-1,  1, 0,   0, 0, -1,   1, 0, 0,   0,   u0, v0,
		 1,  1, 0,   0, 0, -1,   1, 0, 0,   0,   u1, v0,
		 1, -1, 0,   0, 0, -1,   1, 0, 0,   0,   u1, v1,
	};
	unsigned short idx[] = { 0, 1, 2, 0, 2, 3 };
	struct XenosVertexBuffer *vb = Xe_CreateVertexBuffer(xe, sizeof(quad));
	memcpy(Xe_VB_Lock(xe, vb, 0, sizeof(quad), XE_LOCK_WRITE), quad, sizeof(quad)); Xe_VB_Unlock(xe, vb);
	struct XenosIndexBuffer *ib = Xe_CreateIndexBuffer(xe, sizeof(idx), XE_FMT_INDEX16);
	memcpy(Xe_IB_Lock(xe, ib, 0, sizeof(idx), XE_LOCK_WRITE), idx, sizeof(idx)); Xe_IB_Unlock(xe, ib);
	static const float ident[16] = {1,0,0,0, 0,1,0,0, 0,0,1,0, 0,0,0,1};
	float light[4] = {0, 0, -1, 0};

	Xe_SetRenderTarget(xe, gpu_dst);
	t = now();
	for (int i = 0; i < iters + 1; i++) {
		if (i == 1) t = now();              /* first frame warms up */
		Xe_InvalidateState(xe);
		Xe_SetVertexShaderConstantF(xe, 0, ident, 4);
		Xe_SetVertexShaderConstantF(xe, 4, ident, 4);
		Xe_SetPixelShaderConstantF(xe, 0, light, 1);
		Xe_SetShader(xe, SHADER_TYPE_PIXEL, sps, 0);
		Xe_SetShader(xe, SHADER_TYPE_VERTEX, svs, 0);
		Xe_SetZEnable(xe, 0);
		Xe_SetCullMode(xe, XE_CULL_NONE);
		Xe_SetStreamSource(xe, 0, vb, 0, 12);
		Xe_SetIndices(xe, ib);
		Xe_SetTexture(xe, 0, src);
		Xe_DrawIndexedPrimitive(xe, XE_PRIMTYPE_TRIANGLELIST, 0, 0, 4, 0, 2);
		Xe_Resolve(xe);
		Xe_Sync(xe);
	}
	double gpu_ms = (now() - t) * 1000 / iters;

	long diff = 0, diff_rgb = 0; int first = -1;
	for (int y = 0; y < H; y++) for (int x = 0; x < W; x++) {
		int k = xe_tiled_index(x, y, gpu_dst->wpitch / 4);
		if (cd[k] != gd[k]) { diff++; if (first < 0) first = k; }
		if ((cd[k] ^ gd[k]) & 0xffffff00) diff_rgb++;
	}
	printf("%dx%d, %d iterations\n", W, H, iters);
	printf("CPU tiling blit (DRM driver path): %7.2f ms/frame\n", cpu_ms);
	printf("GPU quad + resolve:                %7.2f ms/frame\n", gpu_ms);
	printf("pixels differing: %ld (rgb only: %ld)", diff, diff_rgb);
	if (first >= 0) printf(", first: cpu %08x gpu %08x", cd[first], gd[first]);
	printf("\n");
	xe_dump_ppm("/opt/xegpu/bench_cpu.ppm", cd, W, H, cpu_dst->wpitch / 4, 1);
	xe_dump_ppm("/opt/xegpu/bench_gpu.ppm", gd, W, H, gpu_dst->wpitch / 4, 1);
	xe_linux_close();
	return 0;
}
